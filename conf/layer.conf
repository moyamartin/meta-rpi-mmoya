## conf/layer.conf
```bitbake
# We have a conf and classes directory, add to BBPATH
BBPATH .= ":${LAYERDIR}"

# We have recipes-* directories, add to BBFILES
BBFILES += "${LAYERDIR}/recipes-*/*/*.bb \
            ${LAYERDIR}/recipes-*/*/*.bbappend"

BBFILE_COLLECTIONS += "meta-rpi-mmoya"
BBFILE_PATTERN_meta-rpi-mmoya = "^${LAYERDIR}/"
BBFILE_PRIORITY_meta-rpi-mmoya = "10"

LAYERDEPENDS_meta-rpi-mmoya = "core swupdate"
LAYERSERIES_COMPAT_meta-rpi-mmoya = "scarthgap"

BBFILES_DYNAMIC += " \
    raspberrypi:${LAYERDIR}/dynamic-layers/raspberrypi/*/*/*.bb \
    raspberrypi:${LAYERDIR}/dynamic-layers/raspberrypi/*/*/*.bbappend \
"
```
